#include <stddef.h>
#include <cstring>

#include "common/assert.h"
#include "sd_spi.hpp"
#include "FreeRTOS.h"
#include "task.h"

using namespace drv;
using namespace hal;

#define WAIT_RESPONSE_CNT        10

#define TRANSMITTER_BIT 6
#define END_BIT 0

#define DATA_TOKEN_CMD17_18_24 0xFE
#define DATA_TOKEN_CMD25       0xFC
#define STOP_TOKEN_CMD25       0xFD

#define ERR_TOKEN_MASK             0x1F     /* 7, 6, 5 bits are not used */
#define ERR_TOKEN_ERR              (1 << 0)
#define ERR_TOKEN_CC_ERR           (1 << 1)
#define ERR_TOKEN_ECC_FAIL         (1 << 2)
#define ERR_TOKEN_OUT_OF_RANGE_ERR (1 << 3)
#define ERR_TOKEN_CARD_LOCKED      (1 << 4)

#define DATA_RESP_MASK      0x1F     /* 7, 6, 5 bits are not used */
#define DATA_RESP_START_BIT (1 << 0) /* Should be 1 */
#define DATA_RESP_END_BIT   (1 << 4) /* Should be 0 */
#define DATA_RESP_ACCEPTED  0x05     /* Data accepted */
#define DATA_RESP_CRC_ERR   0x0B     /* Data rejected due to a CRC erro */
#define DATA_RESP_WRITE_ERR 0x0D     /* Data rejected due to a write error */

#define R1_START_BIT 0x80

#define CRC7_CID_CSD_MASK 0xFE

/* crc7 table (crc8 table shifted left by 1 bit ) */
static const uint8_t crc7_table[256] =
{
	0x00, 0x12, 0x24, 0x36, 0x48, 0x5A, 0x6C, 0x7E,
	0x90, 0x82, 0xB4, 0xA6, 0xD8, 0xCA, 0xFC, 0xEE,
	0x32, 0x20, 0x16, 0x04, 0x7A, 0x68, 0x5E, 0x4C,
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	0x8C, 0x9C, 0xA8, 0xBA, 0xC4, 0xD6, 0xE0, 0xF2
};

static const uint16_t crc16_ccitt_table[256] =
{
	0x0000, 0x1021, 0x2042, 0x3063, 0x4084, 0x50A5, 0x60C6, 0x70E7,
	0x8108, 0x9129, 0xA14A, 0xB16B, 0xC18C, 0xD1AD, 0xE1CE, 0xF1EF,
	0x1231, 0x0210, 0x3273, 0x2252, 0x52B5, 0x4294, 0x72F7, 0x62D6,
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	0x6E17, 0x7E36, 0x4E55, 0x5E74, 0x2E93, 0x3EB2, 0x0ED1, 0x1EF0
};

static uint8_t calc_crc7(uint8_t *buff, uint8_t size);
static uint16_t calc_crc16(uint8_t *buff, uint16_t size);

sd_spi::sd_spi(hal::spi &spi, hal::gpio &cs, hal::gpio *cd):
	sd(cd),
	_spi(spi),
	_cs(cs)
{
	ASSERT(_spi.cpol() == spi::CPOL_0);
	ASSERT(_spi.cpha() == spi::CPHA_0);
	ASSERT(_spi.bit_order() == spi::BIT_ORDER_MSB);
	ASSERT(_cs.mode() == gpio::mode::DO && cs.get());
}

sd_spi::~sd_spi()
{
	
}

void sd_spi::select(bool is_selected)
{
	_cs.set(is_selected ? 0 : 1);
}

int8_t sd_spi::init_sd()
{
	/* Send 80 pulses without cs */
	uint8_t init_buff[8];
	memset(init_buff, 0xFF, sizeof(init_buff));
	if(_spi.write(init_buff, sizeof(init_buff)))
		return RES_SPI_ERR;
	
	return RES_OK;
}

void sd_spi::set_speed(uint32_t speed)
{
	_spi.baud(speed);
}

int8_t sd_spi::send_cmd(cmd_t cmd, uint32_t arg, resp_t resp_type, uint8_t *resp)
{
	int8_t res;
	
	if(cmd != CMD12_STOP_TRANSMISSION)
	{
		res = wait_ready();
		if(res)
			return res;
	}
	
	uint8_t cmd_buff[6];
	cmd_buff[0] = (cmd | (1 << TRANSMITTER_BIT)) & ~R1_START_BIT;
	cmd_buff[1] = arg >> 24;
	cmd_buff[2] = arg >> 16;
	cmd_buff[3] = arg >> 8;
	cmd_buff[4] = arg;
	cmd_buff[5] = calc_crc7(cmd_buff, sizeof(cmd_buff) - 1);
	
	if(_spi.write(cmd_buff, sizeof(cmd_buff)))
		return RES_SPI_ERR;

	uint8_t retry_cnt = WAIT_RESPONSE_CNT;
	while(retry_cnt--)
	{
		resp[0] = 0xFF;
		if(_spi.read(resp, 1))
			return RES_SPI_ERR;
		
		if(!(resp[0] & R1_START_BIT))
			break;
	}
	if(!retry_cnt)
		return RES_NO_RESPONSE;
	
	switch(resp_type)
	{
		case R1:
			break;
		
		case R2:
			res = read_data(&resp[1], 16);
			if(res)
				return res;
			
			// Check the CSD or CID CRC7 (last byte):
			// Raw CID CRC7 always has LSB set to 1,
			//so fix it with CRC7_CID_CSD_MASK
			if(calc_crc7(&resp[1], 15) != (resp[16] & CRC7_CID_CSD_MASK))
				return RES_CRC_ERR;
			break;
		
		case R3:
		case R6:
		case R7:
			memset(&resp[1], 0xFF, 4);
			if(_spi.read(&resp[1], 4))
				return RES_SPI_ERR;
	}
	
	return RES_OK;
}

int8_t sd_spi::read_data(void *data, uint16_t size)
{
	uint8_t data_token;
	uint8_t wait_cnt = 10;
	while(wait_cnt--)
	{
		data_token = 0xFF;
		if(_spi.read(&data_token, 1))
			return RES_SPI_ERR;
		
		if(data_token == DATA_TOKEN_CMD17_18_24)
			break;
		/* Check for error token */
		if(!(data_token & ~ERR_TOKEN_MASK))
		{
			if(data_token & ERR_TOKEN_CARD_LOCKED)
				return RES_LOCKED;
			else if(data_token & ERR_TOKEN_OUT_OF_RANGE_ERR)
				return RES_PARAM_ERR;
			else if(data_token & ERR_TOKEN_ECC_FAIL)
				return RES_READ_ERR;
			else if(data_token & ERR_TOKEN_CC_ERR)
				return RES_READ_ERR;
			else if(data_token & ERR_TOKEN_ERR)
				return RES_READ_ERR;
			else
				return RES_READ_ERR;
		}
		vTaskDelay(1);
	}
	if(!wait_cnt)
		return RES_NO_RESPONSE;
	
	memset(data, 0xFF, size);
	if(_spi.read(data, size))
		return RES_SPI_ERR;
	
	uint8_t crc16[2] = {0xFF, 0xFF};
	if(_spi.read(crc16, sizeof(crc16)))
		return RES_SPI_ERR;
	
	if(calc_crc16((uint8_t *)data, size) != ((crc16[0] << 8) | crc16[1]))
		return RES_CRC_ERR;
	
	return RES_OK;
}

int8_t sd_spi::write_data(void *data, uint16_t size)
{
	if(_spi.write(DATA_TOKEN_CMD17_18_24))
		return RES_SPI_ERR;
	
	if(_spi.write(data, size))
		return RES_SPI_ERR;
	
	uint16_t crc16_tmp = calc_crc16((uint8_t *)data, size);
	uint8_t crc16[2] = {(uint8_t)crc16_tmp, (uint8_t)(crc16_tmp << 8)};
	
	if(_spi.write(crc16, sizeof(crc16)))
		return RES_SPI_ERR;
	
	/* Check data response */
	uint8_t data_resp;
	data_resp = 0xFF;
	if(_spi.read(&data_resp, sizeof(data_resp)))
		return RES_SPI_ERR;
	
	if(!(data_resp & DATA_RESP_START_BIT) || (data_resp & DATA_RESP_END_BIT))
	{
		/* Data response is not valid */
		return RES_WRITE_ERR;
	}
	switch(data_resp & DATA_RESP_MASK)
	{
		case DATA_RESP_ACCEPTED: break;
		case DATA_RESP_CRC_ERR: return RES_CRC_ERR;
		case DATA_RESP_WRITE_ERR:
		default: return RES_WRITE_ERR;
	}
	
	return wait_ready();
}

int8_t sd_spi::wait_ready()
{
	uint8_t busy_flag = 0;
	uint16_t wait_cnt = 500;
	
	while(wait_cnt--)
	{
		busy_flag = 0xFF;
		if(_spi.read(&busy_flag, 1))
			return RES_SPI_ERR;
		
		if(busy_flag == 0xFF)
			break;
		
		vTaskDelay(1);
	};
	
	return wait_cnt ? RES_OK : RES_NO_RESPONSE;
}

static uint8_t calc_crc7(uint8_t *buff, uint8_t size)
{
	uint8_t crc = 0;
	
	while(size--)
		crc = crc7_table[crc ^ *buff++];
	
	return crc;
}

static uint16_t calc_crc16(uint8_t *buff, uint16_t size)
{
	uint16_t crc = 0;
	
	while(size--)
		crc = (crc << 8) ^ crc16_ccitt_table[(crc >> 8) ^ *buff++];
	
	return crc;
}
